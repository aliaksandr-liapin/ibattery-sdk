## Kconfig.ibattery
```kconfig
# iBattery SDK — Zephyr Module Kconfig
#
# This file is used when ibattery-sdk is consumed as a Zephyr module.
# The app/Kconfig is for the sample application.

config BATTERY_SDK
    bool "iBattery SDK — battery intelligence library"
    default y
    help
      Enable the iBattery SDK battery monitoring library.
      Provides voltage measurement, SoC estimation, temperature
      monitoring, power state management, and BLE telemetry.

if BATTERY_SDK
rsource "app/Kconfig.battery"
endif
```

## app/boards/nucleo_l476rg.conf
```kconfig
# Board-specific Kconfig for NUCLEO-L476RG
# Auto-loaded by Zephyr build system (app/boards/<board>.conf)

CONFIG_ADC=y

# Disable BLE by default — STM32L476 has no native BLE radio.
# Re-enable with shield: west build ... -- -DSHIELD=x_nucleo_idb05a1
CONFIG_BATTERY_TRANSPORT=n
CONFIG_BT=n

# TP4056 charger GPIO pins on GPIOC (PC6 = CHRG, PC7 = STDBY)
CONFIG_BATTERY_CHARGER_TP4056_CHRG_PIN=6
CONFIG_BATTERY_CHARGER_TP4056_STDBY_PIN=7
```

## app/boards/nucleo_l476rg_ble.conf
```kconfig
# Extra config for NUCLEO-L476RG + X-NUCLEO-IDB05A2 BLE shield.
# Usage: west build ... -- -DSHIELD=x_nucleo_idb05a1 -DEXTRA_CONF_FILE=boards/nucleo_l476rg_ble.conf

# Re-enable BLE transport (board default disables it)
CONFIG_BATTERY_TRANSPORT=y
CONFIG_BATTERY_TRANSPORT_BLE=y
CONFIG_BT=y
CONFIG_BT_PERIPHERAL=y
CONFIG_BT_DEVICE_NAME="iBattery-STM32"
CONFIG_SPI=y
CONFIG_SYSTEM_WORKQUEUE_STACK_SIZE=2048
CONFIG_BT_MAX_CONN=1
CONFIG_BT_MAX_PAIRED=1
# Sized for the largest wire format (v4 = 34 bytes): ATT_MTU >= 34 + 3.
# This conf has no current sense so it emits v3 today, but all BLE configs are
# kept uniform at 37/41 so enabling SoH never silently caps notifications
# (the original 27 capped payloads at 24 bytes and blocked v3 entirely).
CONFIG_BT_L2CAP_TX_MTU=37
CONFIG_BT_BUF_ACL_TX_SIZE=41
CONFIG_BT_BUF_ACL_RX_SIZE=41
```

## app/boards/nucleo_l476rg_ble_current.conf
```kconfig
# NUCLEO-L476RG + X-NUCLEO-IDB05A1 BLE shield + INA219 current sensor.
# Combines BLE telemetry transport with coulomb-counting current sense so the
# v3 current_ma / coulomb_mah fields carry real data over BLE (lights up the
# Live Current + Remaining Charge Grafana panels end-to-end).
#
# Usage: west build -b nucleo_l476rg app -d build-stm32-ble-cur --pristine -- \
#   -DSHIELD=x_nucleo_idb05a1 \
#   -DEXTRA_CONF_FILE=boards/nucleo_l476rg_ble_current.conf \
#   -DZEPHYR_EXTRA_MODULES="/opt/nordic/ncs/v3.2.2/modules/hal/stm32"

# ── BLE transport (board default disables it) ──
CONFIG_BATTERY_TRANSPORT=y
CONFIG_BATTERY_TRANSPORT_BLE=y
CONFIG_BT=y
CONFIG_BT_PERIPHERAL=y
CONFIG_BT_DEVICE_NAME="iBattery-STM32"
CONFIG_SPI=y
CONFIG_SYSTEM_WORKQUEUE_STACK_SIZE=2048
CONFIG_BT_MAX_CONN=1
CONFIG_BT_MAX_PAIRED=1
# v3 telemetry is 32 bytes; a notification needs ATT_MTU >= 32 + 3 (ATT header).
CONFIG_BT_L2CAP_TX_MTU=35
CONFIG_BT_BUF_ACL_TX_SIZE=39
CONFIG_BT_BUF_ACL_RX_SIZE=39

# ── INA219 current sense + coulomb counting ──
CONFIG_I2C=y
CONFIG_BATTERY_CURRENT_SENSE=y
CONFIG_BATTERY_SOC_COULOMB=y
CONFIG_BATTERY_CAPACITY_MAH=220
```
