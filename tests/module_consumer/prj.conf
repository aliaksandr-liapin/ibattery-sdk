## CMakeLists.txt
```
# Minimal Zephyr application that consumes ibattery-sdk as a MODULE
# (root CMakeLists.txt + Kconfig.ibattery via zephyr/module.yml), NOT via the
# app's target_sources path. Build-only smoke test that the module-consumption
# path — the SDK's primary distribution mode — compiles and links.
#
# Build (no flash), with the SDK repo added as an extra module:
#   west build -b nucleo_l476rg tests/module_consumer -d build-mod --pristine -- \
#     -DZEPHYR_EXTRA_MODULES="<sdk-repo-root>" \
#     -DEXTRA_DTC_OVERLAY_FILE="<sdk-repo-root>/app/boards/nucleo_l476rg.overlay"

cmake_minimum_required(VERSION 3.20.0)
find_package(Zephyr REQUIRED HINTS $ENV{ZEPHYR_BASE})
project(ibattery_module_consumer)

target_sources(app PRIVATE src/main.c)
```

## prj.conf
```kconfig
# Enable the SDK via its module Kconfig (Kconfig.ibattery gate). Defaults give
# the core SDK (CR2032, VREFINT voltage, die temp). The CI build additionally
# passes -DCONFIG_BATTERY_SOC_SOH=y etc. to verify the recently-added options
# are exposed by the module Kconfig and that battery_soh.c links via the module
# CMakeLists.
CONFIG_BATTERY_SDK=y
CONFIG_BATTERY_TEMP_DIE=y
```

## src/main.c
```c
/*
 * Module-consumption smoke test: exercise the public SDK entry points so the
 * linker must resolve the whole init chain (incl. battery_soh.c when
 * CONFIG_BATTERY_SOC_SOH=y) through the Zephyr-module build path.
 */
#include <battery_sdk/battery_sdk.h>
#include <battery_sdk/battery_telemetry.h>

int main(void)
{
    struct battery_telemetry_packet pkt;

    (void)battery_sdk_init();
    (void)battery_telemetry_collect(&pkt);
    return 0;
}
```
