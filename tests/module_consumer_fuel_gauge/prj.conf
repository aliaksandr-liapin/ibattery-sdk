## CMakeLists.txt
```
# Minimal Zephyr application that consumes ibattery-sdk as a MODULE and
# exercises the read-only Zephyr fuel_gauge driver (compatible
# "aliaksandr,ibattery-fuel-gauge", gated on CONFIG_BATTERY_FUEL_GAUGE_API).
# Build-only smoke test that the fuel_gauge driver compiles + links through the
# module-consumption path (root CMakeLists.txt + Kconfig.ibattery via
# zephyr/module.yml), NOT via the app's target_sources path.
#
# Build (no flash), with the SDK repo added as an extra module. The consumer's
# own app.overlay provides the fuel_gauge DT node; the board overlay below is
# the platform overlay (ADC etc.):
#   west build -b esp32c3_devkitm tests/module_consumer_fuel_gauge -d build-mod-fg --pristine -- \
#     -DZEPHYR_EXTRA_MODULES="<sdk-repo-root>" \
#     -DEXTRA_DTC_OVERLAY_FILE="<sdk-repo-root>/app/boards/esp32c3_devkitm.overlay"

cmake_minimum_required(VERSION 3.20.0)
find_package(Zephyr REQUIRED HINTS $ENV{ZEPHYR_BASE})
project(ibattery_module_consumer_fuel_gauge)

target_sources(app PRIVATE src/main.c)
```

## prj.conf
```kconfig
# Enable the SDK and its read-only Zephyr fuel_gauge driver via the module
# Kconfig (Kconfig.ibattery gate). CONFIG_BATTERY_FUEL_GAUGE_API instantiates
# the driver from the "aliaksandr,ibattery-fuel-gauge" DT node (provided by the
# consumer's app.overlay) and pulls in the fuel_gauge subsystem, so the linker
# must resolve the driver + subsystem through the module-consumption path.
CONFIG_BATTERY_SDK=y
CONFIG_BATTERY_FUEL_GAUGE_API=y
```

## app.overlay
```dts
/ {
	ibattery_fuel_gauge {
		compatible = "aliaksandr,ibattery-fuel-gauge";
		status = "okay";
	};
};
```

## src/main.c
```c
/*
 * Module-consumption smoke test for the read-only Zephyr fuel_gauge driver.
 * Exercise the public fuel_gauge surface (standard properties + the SDK's
 * custom SoH property) so the linker must resolve the iBattery fuel_gauge
 * driver and the fuel_gauge subsystem through the Zephyr-module build path.
 */
#include <zephyr/device.h>
#include <zephyr/drivers/fuel_gauge.h>
#include <battery_sdk/battery_sdk.h>
#include <battery_sdk/battery_fuel_gauge.h>

int main(void)
{
    const struct device *fg = DEVICE_DT_GET_ANY(aliaksandr_ibattery_fuel_gauge);
    union fuel_gauge_prop_val val;

    (void)battery_sdk_init();
    if (fg != NULL && device_is_ready(fg)) {
        (void)fuel_gauge_get_prop(fg, FUEL_GAUGE_VOLTAGE, &val);
        (void)fuel_gauge_get_prop(fg, FUEL_GAUGE_RELATIVE_STATE_OF_CHARGE, &val);
        (void)fuel_gauge_get_prop(fg, BATTERY_FUEL_GAUGE_PROP_SOH, &val);
    }
    return 0;
}
```
