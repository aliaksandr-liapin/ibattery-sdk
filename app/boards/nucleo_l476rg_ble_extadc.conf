## dts/bindings/fuel-gauge/aliaksandr,ibattery-fuel-gauge.yaml
```yaml
description: iBattery SDK virtual fuel gauge (software, read-only)
compatible: "aliaksandr,ibattery-fuel-gauge"
include: [base.yaml]
```
